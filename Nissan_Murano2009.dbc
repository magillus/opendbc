VERSION ""

NS_ :

BS_:

BU_: XXX

BO_ 1376 NEW_MSG_1: 8 XXX

BO_ 374 GAS_ENGINE: 8 XXX
 SG_ GAS_pedal : 19|12@0+ (1,0) [0|1023] "" XXX
 SG_ COUNTER : 51|4@0+ (1,0) [0|65535] "" XXX

BO_ 421 NEW_MSG_2: 8 XXX
 SG_ COUNTER : 7|4@0+ (1,0) [0|15] "" XXX
 SG_ NEW_SIGNAL_1 : 23|8@0+ (1,0) [0|255] "" XXX

BO_ 1408 NEW_MSG_3: 8 XXX
 SG_ NEW_SIGNAL_1 : 8|4@1+ (1,0) [0|15] "" XXX
