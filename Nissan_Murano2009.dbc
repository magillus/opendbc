VERSION ""

NS_ :

BS_:

BU_: XXX

BO_ 1376 NEW_MSG_1: 8 XXX

BO_ 374 GAS_ENGINE: 8 XXX
 SG_ GAS_pedal : 19|12@0+ (1,0) [0|1023] "" XXX
